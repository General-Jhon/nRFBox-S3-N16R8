#include "boot_animation.h"

// Parámetros OLED
#define ANCHO_PANTALLA 128
#define ALTO_PANTALLA 64
#define LOGO_WIDTH 84
#define LOGO_HEIGHT 52

extern Adafruit_NeoPixel pixels;
extern Adafruit_SSD1306 display;

// ===== LOGO =====
const unsigned char PROGMEM logo[] = {
  0x00,0x00,0x00,0x00,0x00,0x00,0x00,0x00,0x00,0x00,0x00,0x00,0x00,0x00,0x00,0x00,
  0x00,0x00,0x00,0x00,0x00,0x00,0x00,0x00,0x00,0x00,0x00,0x00,0x00,0x00,0x00,0x00,
  0x00,0x00,0x00,0x00,0x00,0x00,0x00,0x00,0x00,0x00,0x00,0x00,0x00,0x00,0x00,0x00,
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  0x00,0x00
};

// ==== Estructura de bits (efecto Matrix) ====
struct Bit { float x, y, tx, ty; char value; };
#define NUM_BITS 40
static Bit bits[NUM_BITS];

static void initBits() {
  for (int i = 0; i < NUM_BITS; i++) {
    bits[i].x = random(0, ANCHO_PANTALLA);
    bits[i].y = random(-ALTO_PANTALLA, 0);
    bits[i].tx = ANCHO_PANTALLA / 2 + random(-10, 10);
    bits[i].ty = ALTO_PANTALLA / 2 + random(-6, 6);
    bits[i].value = random(2) ? '1' : '0';
  }
}

static void drawRain() {
  display.clearDisplay();
  display.setTextSize(1);
  display.setTextColor(WHITE);
  for (int i = 0; i < NUM_BITS; i++) {
    display.setCursor(bits[i].x, bits[i].y);
    display.write(bits[i].value);
    bits[i].y += random(2, 6);
    if (bits[i].y > ALTO_PANTALLA + 5) {
      bits[i].y = random(-10, 0);
      bits[i].x = random(0, ANCHO_PANTALLA);
    }
  }
  display.display();
}

static void convergeAndFadeOut() {
  for (int frame = 0; frame < 40; frame++) {
    display.clearDisplay();

    for (int i = 0; i < NUM_BITS; i++) {
      // Movimiento suave hacia el punto objetivo
      bits[i].x += (bits[i].tx - bits[i].x) * 0.25;
      bits[i].y += (bits[i].ty - bits[i].y) * 0.25;

      // 🔥 Desvanecimiento progresivo: los bits desaparecen al acercarse
      float dx = abs(bits[i].tx - bits[i].x);
      float dy = abs(bits[i].ty - bits[i].y);
      float dist = sqrt(dx * dx + dy * dy);

      if (dist > 3) { // aún lejos → visible
        display.setCursor(bits[i].x, bits[i].y);
        display.write(bits[i].value);
      }
    }

    // Efecto NeoPixel sincronizado
    if (frame < 15)
      pixels.setPixelColor(0, pixels.Color(0, 0, 30));
    else if (frame < 30)
      pixels.setPixelColor(0, pixels.Color(0, 120, 40));
    else
      pixels.setPixelColor(0, pixels.Color(0, 255, 80));

    pixels.show();

    display.display();
    delay(30);
  }

  // 🧹 Limpieza final
  display.clearDisplay();
  display.display();
  pixels.clear();
  pixels.show();
}







static void glitchLogoAggressive(int duration) {
  int x = (display.width() - LOGO_WIDTH) / 2;
  int y = (display.height() - LOGO_HEIGHT) / 2;
  unsigned long start = millis();

  while (millis() - start < duration) {
    display.clearDisplay();
    int xOffset = random(-4, 5);
    int yOffset = random(-4, 5);
    bool invert = random(0, 3) == 0;
    display.drawBitmap(x + xOffset, y + yOffset, logo, LOGO_WIDTH, LOGO_HEIGHT, invert ? BLACK : WHITE);

    // Líneas aleatorias glitch
    if (random(0, 5) == 0)
      display.fillRect(random(0, ANCHO_PANTALLA - 10), random(0, ALTO_PANTALLA - 2), random(5, 20), 1, WHITE);

    // 💡 Efecto de color NeoPixel
    int mode = random(0, 3);
    if (mode == 0) pixels.setPixelColor(0, pixels.Color(255, random(0, 50), 0));
    else if (mode == 1) pixels.setPixelColor(0, pixels.Color(255, 180, 0));
    else pixels.setPixelColor(0, pixels.Color(255, 255, 255));

    pixels.show();
    display.display();
    delay(random(15, 40));
  }

  pixels.clear();
  pixels.show();
  display.clearDisplay();
  display.drawBitmap(x, y, logo, LOGO_WIDTH, LOGO_HEIGHT, WHITE);
  display.display();
  delay(300);
}

static void explosionFlash() {
  display.fillRect(0, 0, ANCHO_PANTALLA, ALTO_PANTALLA, WHITE);
  display.display();
  pixels.setPixelColor(0, pixels.Color(255, 255, 255));
  pixels.show();
  delay(60);
  display.clearDisplay();
  display.display();
  pixels.clear();
  pixels.show();
}

static void explodeBits() {
  for (int i = 0; i < NUM_BITS; i++) {
    bits[i].x = ANCHO_PANTALLA / 2 + random(-5, 5);
    bits[i].y = ALTO_PANTALLA / 2 + random(-5, 5);
    bits[i].tx = random(-7, 7);
    bits[i].ty = random(-5, 5);
  }

  for (int frame = 0; frame < 20; frame++) {
    display.clearDisplay();
    for (int i = 0; i < NUM_BITS; i++) {
      bits[i].x += bits[i].tx;
      bits[i].y += bits[i].ty;
      display.setCursor(bits[i].x, bits[i].y);
      display.write(bits[i].value);
    }
    if (frame % 2 == 0) {
      int x = (display.width() - LOGO_WIDTH) / 2;
      int y = (display.height() - LOGO_HEIGHT) / 2;
      display.drawBitmap(x, y, logo, LOGO_WIDTH, LOGO_HEIGHT, WHITE);
    }
    pixels.setPixelColor(0, pixels.Color(255, random(50, 200), 0));
    pixels.show();
    display.display();
    delay(25);
  }
  pixels.clear();
  pixels.show();
}

static void showFinalLogoAndText() {
  int x = (display.width() - LOGO_WIDTH) / 2;
  int y = (display.height() - LOGO_HEIGHT) / 2;
  display.clearDisplay();
  display.drawBitmap(x, y, logo, LOGO_WIDTH, LOGO_HEIGHT, WHITE);
  display.display();

  pixels.setPixelColor(0, pixels.Color(0, 150, 0));
  pixels.show();
  delay(800);

  String title = "NRFBOX";
  String author = "by General_Jhon";

  for (int i = 0; i < title.length(); i++) {
    display.setTextSize(2);
    display.setTextColor(WHITE);
    display.setCursor(25 + i * 17, 2);
    display.write(title[i]);
    display.display();
    delay(70);
  }

  for (int i = 0; i < author.length(); i++) {
    display.setTextSize(1);
    display.setTextColor(WHITE);
    display.setCursor(20 + i * 6, 56);
    display.write(author[i]);
    display.display();
    delay(55);
  }

  delay(2000);
  pixels.clear();
  pixels.show();
}

void bootAnimation() {
  initBits();

  // 🌧️ Lluvia tipo Matrix
  for (int i = 0; i < 55; i++) {
    drawRain();
    delay(30);
  }

  // 🔄 Agrupación + Fade
  convergeAndFadeOut();

  // ⚡ Glitch agresivo del logo
  glitchLogoAggressive(1500);

  // 💥 Explosión tipo flash
  explosionFlash();
  explodeBits();

  // 💀 Logo final + texto NRFBOX
  showFinalLogoAndText();

  // 🟢 Limpieza final
  display.clearDisplay();
  display.display();
  pixels.clear();
  pixels.show();
}


